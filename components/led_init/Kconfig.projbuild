## components/led_init/Kconfig.projbuild
```kconfig
menu "LED Configuration"

    choice LED_STATUS_TYPE
        prompt "Status RGB LED type"
        default LED_STATUS_NONE
        help
            Select the status RGB LED implementation.

        config LED_STATUS_NONE
            bool "None"

        config LED_STATUS_WS2812
            bool "LED RGB (WS2812) ESP35-C5-DevKitC-1"

    endchoice

    config LED_STATUS_WS2812_GPIO
        int "WS2812 data GPIO"
        default 27
        range -1 30
        depends on LED_STATUS_WS2812

    config LED_STATUS_WS2812_NUM_LEDS
        int "WS2812 number of LEDs"
        default 1
        range 1 16
        depends on LED_STATUS_WS2812

    # Tu RGB por MOSFET (dumb)
    config LED_GRN_GPIO
        int "LED green GPIO"
        default 14
        range -1 30

    config LED_BLU_GPIO
        int "LED blue GPIO"
        default 25
        range -1 30

    config LED_RED_GPIO
        int "LED red GPIO"
        default 26
        range -1 30

endmenu
```

## components/sub_init/Kconfig.projbuild
```kconfig
menu "Sub-GHz / STM32WL UART"

config SUB_UART_ENABLE
    bool "Enable Sub-GHz UART bridge"
    default y

config SUB_UART_PORT_NUM
    int "Sub-GHz UART port number"
    default 1
    range 1 2
    depends on SUB_UART_ENABLE

config SUB_UART_TX_GPIO
    int "Sub-GHz UART TX GPIO"
    default 23
    range -1 30
    depends on SUB_UART_ENABLE

config SUB_UART_RX_GPIO
    int "Sub-GHz UART RX GPIO"
    default 24
    range -1 30
    depends on SUB_UART_ENABLE

config SUB_UART_BAUD
    int "Sub-GHz UART baudrate"
    default 115200
    depends on SUB_UART_ENABLE

config SUB_NRST_GPIO
    int "Sub module nRST GPIO"
    default -1
    range -1 30
    help
        GPIO used to reset the Sub-GHz/STM32WL module (active-low). Set -1 to disable.

endmenu
```

## main/Kconfig.projbuild
```kconfig
menu "Example Configuration"
    config EXAMPLE_ETH_DEINIT_AFTER_S
        int "Stop and deinit Ethernet after elapsing number of secs"
        range -1 300
        default -1
        help
            This option is for demonstration purposes only to demonstrate deinitialization of the Ethernet driver.
            Set to -1 to not deinitialize.

    config HUB_PAIR_BUTTON_GPIO
        int "Pairing button GPIO"
        range -1 30
        default 5
        help
            GPIO used for the hub pairing button. Hold it for the configured
            duration to enter pairing mode. Set to -1 to disable hardware button support.

    config HUB_PAIR_BUTTON_ACTIVE_LOW
        bool "Pairing button is active low"
        default y
        depends on HUB_PAIR_BUTTON_GPIO >= 0

    config HUB_PAIR_BUTTON_PULLUP
        bool "Enable internal pull-up for pairing button"
        default y
        depends on HUB_PAIR_BUTTON_GPIO >= 0

    config HUB_PAIR_HOLD_MS
        int "Pairing button hold time (ms)"
        range 1000 60000
        default 10000

    config HUB_PAIR_WINDOW_MS
        int "Pairing window duration (ms)"
        range 1000 300000
        default 60000

    config HUB_PAIR_ACK_DELAY_MS
        int "ACK command delay to STM32 (ms)"
        range 100 5000
        default 1000

    config HUB_PAIR_MAX_NODES
        int "Maximum paired nodes"
        range 1 64
        default 16
endmenu
```
